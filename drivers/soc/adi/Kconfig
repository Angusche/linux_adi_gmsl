## drivers/soc/adi/Kconfig
```kconfig
# SPDX-License-Identifier: GPL-2.0-only

config ADI_SYSTEM_CONFIG
	bool "ADI System Config" if COMPILE_TEST
	default ARCH_SC59X_64 || ARCH_SC5XX
	select REGMAP_MMIO
	help
	  This enables support for the ADI System Config system, which
	  provides a regmap interface to system configuration registers.

config ADI_PADS_SYSTEM
	tristate "ADI PADS System Config driver"
	default ARCH_SC59X_64 || ARCH_SC5XX
	depends on ARCH_SC59X_64 || ARCH_SC5XX || COMPILE_TEST
	select ADI_SYSTEM_CONFIG
	help
	  This enables support for the ADI PADS System Config driver,
	  which manages pin configuration and other system settings.

config ADI_SC59X_SMPU
	tristate "ADI SC59x System Memory Protection Unit"
	depends on ARCH_SC59X_64 || COMPILE_TEST
	default ARCH_SC59X_64
	help
	  This enables support for the SMPU (System Memory Protection Unit)
	  on Analog Devices SC59x processors (SC595/SC596/SC598).
```
